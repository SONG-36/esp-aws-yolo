## Kconfig
```kconfig
# 顶层 Kconfig
menu "Project Configuration"

source "MiddleWare/HAL_Driver/Kconfig"

source "Driver/esp32s3/esp32-camera/Kconfig"

endmenu
```

## MiddleWare/Utils/Kconfig
```kconfig
    menu "SPIFFS - Virtual File System"
        config BSP_SPIFFS_FORMAT_ON_MOUNT_FAIL
            bool "Format SPIFFS if mounting fails"
            default n
            help
                Format SPIFFS if it fails to mount the filesystem.

        config BSP_SPIFFS_MOUNT_POINT
            string "SPIFFS mount point"
            default "/spiffs"
            help
                Mount point of SPIFFS in the Virtual File System.

        config BSP_SPIFFS_PARTITION_LABEL
            string "Partition label of SPIFFS"
            default "storage"
            help
                Partition label which stores SPIFFS.

        config BSP_SPIFFS_MAX_FILES
            int "Maximum files that could be open at the same time"
            default 2
            help
                Supported max files for SPIFFS in the Virtual File System.
    endmenu
```
